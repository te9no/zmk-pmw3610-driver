## dts/bindings/behaviors/zmk,behavior-ball-action.yaml
```yaml
description: Ball Action Behavior

compatible: "zmk,behavior-ball-action"

properties:
  bindings:
    type: phandle-array
    required: true
  up-keycode:
    type: int
    required: true
  down-keycode:
    type: int
    required: true
  left-keycode:
    type: int
    required: true
  right-keycode:
    type: int
    required: true
  threshold:
    type: int
    default: 10
```

## dts/bindings/pixart,pmw3610.yml
```yaml
description: |
  Sensor driver for the pixart PMW3610 mouse sensor 

compatible: "pixart,pmw3610"

include: spi-device.yaml

properties:
  irq-gpios:
    type: phandle-array
    required: true
  cpi:
    type: int
    default: 600
    description: "CPI value (Range: 200 - 3200, Step: 200)"
  evt-type:
    type: int
  x-input-code:
    type: int
  y-input-code:
    type: int
  force-awake:
    type: boolean
  scroll-layers:
    type: array
    description: "Layers where the sensor acts as a scroll wheel"
  snipe-layers:
    type: array
    description: "Layers where the sensor uses snipe mode (lower CPI)"
  ball-actions:
    type: phandle-array
    description: "References to child nodes containing ball action configurations"

child-binding:
  description: "Ball action configuration for specific layers"
  properties:
    compatible:
      type: string
      const: "zmk,behavior-ball-action"
    label:
      type: string
      description: "Human readable string describing the ball action"
    layers:
      type: array
      description: "Layers on which the behavior will be invoked"
    bindings:
      type: phandle-array
      description: "Behaviors to be invoked when ball movement exceeds the tick threshold"
    tick:
      type: int
      description: "Required ticks to trigger a ball action. Higher values require more movement."
    wait-ms:
      type: int
      description: "Time to wait before triggering the next behavior binding"
    tap-ms:
      type: int
      description: "Time between press and release events on a triggered binding"
```

## dts/bindings/sensor/pixart,pmw3610.yaml
```yaml
# Copyright (c) 2022 The ZMK Contributors
#
# SPDX-License-Identifier: MIT
#
# Binding file for PixArt PMW3610 sensor
#

description: |-
  PixArt PMW3610 is a high-performance optical sensor for motion detection.
  This binding describes the PMW3610 sensor properties and settings.

properties:
  compatible:
    const: pixart,pmw3610

  reg:
    maxItems: 1

  spi-max-frequency:
    description: |-
      Maximum frequency of the SPI bus in Hertz. This is used to configure the
      sensor's SPI interface.
    type: integer
    default: 8000000

  cpi:
    description: |-
      Counts per inch (CPI) setting for the sensor. This value determines the
      sensitivity of the motion detection. Higher CPI values result in higher
      sensitivity.
    type: integer
    default: 800

  evt_type:
    description: |-
      Event type for reporting motion events. This property defines the type of
      event that will be generated by the sensor when motion is detected.
    type: integer
    default: 0

  x_input_code:
    description: |-
      Input code for the X-axis motion reporting. This property defines the input
      code that will be used to report X-axis motion events.
    type: integer
    default: 0

  y_input_code:
    description: |-
      Input code for the Y-axis motion reporting. This property defines the input
      code that will be used to report Y-axis motion events.
    type: integer
    default: 0

  force_awake:
    description: |-
      Force the sensor to stay awake and not enter low-power modes. This is useful
      for applications that require constant monitoring of motion.
    type: boolean
    default: false

  ball-action:
    type: boolean
    description: Enable ball action support
    
  ball-threshold-up:
    type: int
    default: 10
    description: Threshold for upward movement
    
  ball-threshold-down:
    type: int
    default: 10
    description: Threshold for downward movement
    
  ball-threshold-left:
    type: int
    default: 10
    description: Threshold for leftward movement
    
  ball-threshold-right:
    type: int
    default: 10
    description: Threshold for rightward movement

required:
  - compatible
  - reg
  - spi-max-frequency
  - cpi
  - evt_type
  - x_input_code
  - y_input_code
  - force_awake
  - ball-action
  - ball-threshold-up
  - ball-threshold-down
  - ball-threshold-left
  - ball-threshold-right

additionalProperties: false
```
